## firmware/esp32_s3_lvgl/sdkconfig.defaults
```kconfig
CONFIG_IDF_TARGET="esp32s3"
CONFIG_ESP_MAIN_TASK_STACK_SIZE=8192

# 7-inch RGB + LVGL buffers should use PSRAM.
CONFIG_SPIRAM=y
CONFIG_SPIRAM_MODE_OCT=y
CONFIG_SPIRAM_SPEED_80M=y
CONFIG_SPIRAM_USE_MALLOC=y

CONFIG_FREERTOS_HZ=1000
CONFIG_ESP_TIMER_SUPPORTS_ISR_DISPATCH_METHOD=y

CONFIG_PARTITION_TABLE_CUSTOM=y
CONFIG_PARTITION_TABLE_CUSTOM_FILENAME="partitions.csv"
CONFIG_ESPTOOLPY_FLASHSIZE_16MB=y

# LVGL 9
CONFIG_LV_USE_MATRIX=y
CONFIG_LV_DRAW_TRANSFORM_USE_MATRIX=y
CONFIG_LV_COLOR_DEPTH_16=y
CONFIG_LV_DEF_REFR_PERIOD=16
CONFIG_LV_USE_LABEL=y
CONFIG_LV_USE_BUTTON=y
CONFIG_LV_USE_BAR=y
CONFIG_LV_USE_IMAGE=y
CONFIG_LV_USE_ARC=y
CONFIG_LV_USE_FLEX=y
CONFIG_LV_FONT_MONTSERRAT_20=y
CONFIG_LV_FONT_MONTSERRAT_24=y
CONFIG_LV_FONT_MONTSERRAT_28=y
CONFIG_LV_FONT_MONTSERRAT_36=y
CONFIG_LV_FONT_DEFAULT_MONTSERRAT_20=y
# CONFIG_LV_BUILD_EXAMPLES is not set
# CONFIG_LV_BUILD_DEMOS is not set
# CONFIG_LV_USE_THORVG is not set
# CONFIG_LV_USE_VECTOR_GRAPHIC is not set

CONFIG_WS_BUFFER_SIZE=8192
CONFIG_ESP_WS_CLIENT_SEPARATE_TX_LOCK=y

# LVGL 分块刷屏时 IDLE 任务可能无法及时喂狗
CONFIG_ESP_TASK_WDT_CHECK_IDLE_TASK_CPU0=n
CONFIG_ESP_TASK_WDT_CHECK_IDLE_TASK_CPU1=n
CONFIG_ESP_TASK_WDT_TIMEOUT_S=10

# LVGL 内置堆 + PSRAM 扩展池；draw layer 需要更大空间
CONFIG_LV_MEM_SIZE_KILOBYTES=96
```

## firmware/esp32_s3_sub_display/sdkconfig.defaults
```kconfig
CONFIG_IDF_TARGET="esp32s3"
CONFIG_ESP_MAIN_TASK_STACK_SIZE=8192

CONFIG_SPIRAM=y
CONFIG_SPIRAM_MODE_OCT=y
CONFIG_SPIRAM_SPEED_80M=y
CONFIG_SPIRAM_USE_MALLOC=y

CONFIG_FREERTOS_HZ=1000
CONFIG_ESP_TIMER_SUPPORTS_ISR_DISPATCH_METHOD=y

CONFIG_PARTITION_TABLE_CUSTOM=y
CONFIG_PARTITION_TABLE_CUSTOM_FILENAME="partitions.csv"
CONFIG_ESPTOOLPY_FLASHSIZE_16MB=y

CONFIG_LV_USE_MATRIX=y
CONFIG_LV_DRAW_TRANSFORM_USE_MATRIX=y
CONFIG_LV_COLOR_DEPTH_16=y
CONFIG_LV_DEF_REFR_PERIOD=16
CONFIG_LV_USE_LABEL=y
CONFIG_LV_USE_BUTTON=y
CONFIG_LV_USE_BAR=y
CONFIG_LV_USE_FLEX=y
CONFIG_LV_FONT_MONTSERRAT_14=y
CONFIG_LV_FONT_MONTSERRAT_20=y
CONFIG_LV_FONT_MONTSERRAT_28=y
CONFIG_LV_FONT_DEFAULT_MONTSERRAT_20=y

CONFIG_FATFS_LFN_HEAP=y
CONFIG_LV_USE_IMAGE=y
CONFIG_LV_USE_LODEPNG=y
CONFIG_LV_USE_FS_POSIX=y
CONFIG_LV_FS_POSIX_LETTER=65
CONFIG_LV_FS_POSIX_PATH="/sdcard"
CONFIG_LV_FS_POSIX_CACHE_SIZE=16384

CONFIG_ESP_TASK_WDT_CHECK_IDLE_TASK_CPU0=n
CONFIG_ESP_TASK_WDT_CHECK_IDLE_TASK_CPU1=n
CONFIG_ESP_TASK_WDT_TIMEOUT_S=10

CONFIG_LV_MEM_SIZE_KILOBYTES=128
```
