## firmware-ai-dog/main/Kconfig.projbuild
```kconfig
# 项目配置：只保留 OTA_URL / BOARD 二选一 choice / 语言 / 唤醒词

menu "Kyle Firmware"

config OTA_URL
    string "Default OTA URL"
    default "http://192.168.0.114:8080/api/iot/ota/"
    help
        首次激活的默认 OTA 基地址（指向自建 admin-backend）；NVS wifi/ota_url 可覆盖。

choice BOARD
    prompt "Board selection"
    default BOARD_SUPERMINI_C3
    help
        构建时二选一，只编译选中的一块板。

config BOARD_SUPERMINI_C3
    bool "supermini-c3 (ESP32-C3, SSD1306 OLED, 4MB)"
    depends on IDF_TARGET_ESP32C3

config BOARD_KYLE_S3_LCD
    bool "kyle-s3-lcd (ESP32-S3, ST7789 + touch, 16MB/PSRAM)"
    depends on IDF_TARGET_ESP32S3

endchoice

config WIFI_SSID
    string "Default WiFi SSID"
    default ""
    help
        配网兜底 SSID（NVS wifi/ssid 为空时使用；menuconfig 填写，不进代码仓库）。

config WIFI_PASSWORD
    string "Default WiFi password"
    default ""
    help
        配网兜底密码（NVS wifi/password 为空时使用；menuconfig 填写，不进代码仓库）。
        生产环境应通过配网流程写入 NVS，此处仅作为开发期兜底。

config LANGUAGE
    string "Language code"
    default "zh-CN"
    help
        用于系统信息上报与显示语言（如 zh-CN / en-US）。

# 固件版本号统一使用 IDF 官方 CONFIG_APP_PROJECT_VER（esp_app_format 组件提供，
# 需开启 APP_PROJECT_VER_FROM_CONFIG）：它与 esp_app_desc.version（app_init 启动日志
# 的 "App version"）同源，避免曾出现的「自定义 FIRMWARE_VERSION 与 PROJECT_VER 两套
# 版本号脱节 → OTA 上报永远落后 → 无限重启循环」。版本在 menuconfig
# "Application manager" 下设置，并在 sdkconfig.defaults.esp32s3 中同步。

config WAKE_WORD
    string "Wake word text"
    default "铃铛象"
    help
        唤醒词文本；supermini-c3 用 Wakenet、kyle-s3-lcd 用 Multinet。

config AUDIO_SELFTEST
    bool "Run K3 audio self-test on boot"
    default y
    help
        K3 真机验证用：启动后先播 440Hz 正弦（扬声器可闻），再循环打印麦克风电平。
        K6 音频流水线接入后置 n。

endmenu
```

## firmware-ai-dog/sdkconfig.defaults.esp32c3
```kconfig
# ESP32-C3：supermini-c3（4MB Flash，无 PSRAM，SSD1306 OLED）
CONFIG_IDF_TARGET="esp32c3"
CONFIG_BOARD_SUPERMINI_C3=y
CONFIG_ESPTOOLPY_FLASHSIZE_4MB=y
```

## firmware/esp32_s3_sub_display/main/Kconfig.projbuild
```kconfig
menu "Pomodoro PC Sync"

    config POMO_SYNC_ENABLE
        bool "Enable pomodoro backend sync (WiFi + HTTP)"
        default y
        help
            Sync pomodoro state with admin-backend via LAN.
            ESP cannot use 127.0.0.1 (that points to ESP itself).

            When PC DHCP IP changes often, prefer one of:
            - SD file /sdcard/config/pomodoro_host.txt (no reflash)
            - Router DHCP reservation for your PC
            - PC hostname with mDNS, e.g. MYPC.local

    config POMO_API_HOST
        string "Backend host (fallback if no SD config)"
        default "192.168.0.122"
        depends on POMO_SYNC_ENABLE
        help
            IP (192.168.x.x) or hostname (MYPC.local).
            Overridden by SD card config/pomodoro_host.txt when present.

    config POMO_API_PORT
        int "Backend HTTP port"
        default 8080
        depends on POMO_SYNC_ENABLE

    config WIFI_SSID
        string "WiFi SSID"
        default "YOUR_SSID"
        depends on POMO_SYNC_ENABLE

    config WIFI_PASSWORD
        string "WiFi password"
        default "YOUR_PASSWORD"
        depends on POMO_SYNC_ENABLE

endmenu

menu "Pixel Dog"

    config PIXEL_DOG_SYNC_ENABLE
        bool "Enable pixel dog backend sync (WiFi + HTTP)"
        default y
        help
            Sync pixel dog state with admin-backend via LAN.

    config PIXEL_DOG_API_HOST
        string "Pixel Dog backend host (fallback if no SD config)"
        default "192.168.0.122"
        depends on PIXEL_DOG_SYNC_ENABLE
        help
            IP (192.168.x.x) or hostname (MYPC.local).
            Overridden by SD card config/pixel_dog_host.txt when present.

    config PIXEL_DOG_API_PORT
        int "Pixel Dog backend HTTP port"
        default 8080
        depends on PIXEL_DOG_SYNC_ENABLE

endmenu
```
